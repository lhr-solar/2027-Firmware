VERSION "2027-draft-2026-10-22"

NS_ :

BS_:

BU_: VCU WS22
VAL_TABLE_ EnableDisable 1 "Enabled" 0 "Disabled" ;
VAL_TABLE_ OnOff 1 "On" 0 "Off" ;
VAL_TABLE_ FaultState 1 "Fault" 0 "OK" ;
VAL_TABLE_ WarningState 1 "Warning" 0 "NoWarning" ;
VAL_TABLE_ DeviceStatus 2 "Waiting" 1 "Fault" 0 "OK" ;
VAL_TABLE_ Permission 1 "Allowed" 0 "NotAllowed" ;
VAL_TABLE_ Connection 1 "Connected" 0 "Disconnected" ;
VAL_TABLE_ BalancingMode 2 "Manual" 1 "Automatic" 0 "Off" ;
VAL_TABLE_ BalancingState 4 "BlockedOrFault" 3 "Complete" 2 "Paused" 1 "Balancing" 0 "Off" ;
VAL_TABLE_ BalancingBlockReason 7 "Other" 6 "BPSFault" 5 "Communication" 4 "VehicleState" 3 "CellVoltage" 2 "ChipTemperature" 1 "CellTemperature" 0 "None" ;
VAL_TABLE_ ServerConnection 1 "Connected" 0 "Disconnected/Retrying" ;
VAL_TABLE_ Pressed 1 "Pressed" 0 "NotPressed" ;
VAL_TABLE_ Validity 1 "Valid" 0 "Invalid" ;
VAL_TABLE_ Watchdog 1 "TimedOut" 0 "Alive" ;
VAL_TABLE_ NormalAdvanced 1 "Advanced" 0 "Normal" ;
VAL_TABLE_ MotorCommandSource 1 "External" 0 "VCU" ;
VAL_TABLE_ Gear 3 "Invalid" 2 "Reverse" 1 "Forward" 0 "Neutral" ;
VAL_TABLE_ BPSFaultSummary 5 "SMBFault" 4 "PrechargeFault" 3 "ContactorRelayFault" 2 "EmergencyStop" 1 "SetpointFault" 0 "OK" ;
VAL_TABLE_ VCUState 7 "VehicleNotReady" 6 "Disabled" 5 "CruiseControl" 4 "Regen" 3 "ReverseDrive" 2 "NeutralDrive" 1 "ForwardDrive" 0 "Init" ;
VAL_TABLE_ ChargeState 2 "Charging" 1 "Standby" 0 "Disabled" ;
VAL_TABLE_ EVSEState 5 "F_EVSEFault" 4 "E_Fault" 3 "D_VentilationRequired" 2 "C_ChargingReady" 1 "B_Connected" 0 "A_Disconnected" ;
VAL_TABLE_ GPSAntennaState 3 "Unknown" 2 "ShortCircuit" 1 "OpenCircuit" 0 "OK" ;
VAL_TABLE_ GPSFix 2 "Fix3D" 1 "Fix2D" 0 "NoFix" ;
VAL_TABLE_ CellularTechnology 4 "Other" 3 "NB_IoT" 2 "LTE_M" 1 "LTE" 0 "None" ;
VAL_TABLE_ TPEEControlMode 2 "ConstantInputVoltage" 1 "PerturbAndObserve" 0 "Disabled" ;
VAL_TABLE_ TPEEOperatingMode 7 "Fault" 6 "MinimumInputVoltage" 5 "TemperatureDerating" 4 "ConstantOutputCurrent" 3 "ConstantOutputVoltage" 2 "MinimumInputCurrent" 1 "ConstantInputCurrent" 0 "ConstantInputVoltage" ;
VAL_TABLE_ TPEEFault 8 "Fault" 7 "PhaseOverCurrent" 6 "InputUnderCurrent" 5 "InputOverCurrent" 4 "OutputOverCurrent" 3 "OutputOverVoltage" 2 "InputOverVoltage" 1 "ConfigurationError" 0 "OK" ;
VAL_TABLE_ LWSCalibration 1 "Calibrated" 0 "NotCalibrated" ;
VAL_TABLE_ LWSTrim 1 "Trimmed" 0 "NotTrimmed" ;
VAL_TABLE_ LWSCommand 5 "ResetCalibration" 3 "SetAngleZero" ;
VAL_TABLE_ ElconControl 1 "Disable" 0 "Charge" ;
VAL_TABLE_ ElconMuxPage 5 "Page5" 4 "Page4" 3 "Page3" 2 "Page2" 1 "Page1" ;

BO_ 1025 MC_DriveCommand: 8 VCU
 SG_ MC_MotorVelocitySetpoint : 0|32@1- (1,0) [0|0] "rpm" Vector__XXX
 SG_ MC_MotorCurrentSetpoint : 32|32@1- (1,0) [0|1] "ratio" Vector__XXX

BO_ 1026 MC_PowerCommand: 8 VCU
 SG_ MC_MotorPowerSetpoint : 32|32@1- (1,0) [0|1] "ratio" Vector__XXX

BO_ 1027 MC_ResetCommand: 8 VCU

BO_ 1056 MC_Info: 8 WS22
 SG_ MC_TritiumID : 0|32@1+ (1,0) [0|0] "" Vector__XXX
 SG_ MC_SerialNumber : 32|32@1+ (1,0) [0|0] "" Vector__XXX

BO_ 1057 MC_Status: 8 WS22
 SG_ MC_LIMIT_OutputVoltagePWM : 0|1@1+ (1,0) [0|1] "" Vector__XXX
 SG_ MC_LIMIT_MotorCurrent : 1|1@1+ (1,0) [0|1] "" Vector__XXX
 SG_ MC_LIMIT_Velocity : 2|1@1+ (1,0) [0|1] "" Vector__XXX
 SG_ MC_LIMIT_BusCurrent : 3|1@1+ (1,0) [0|1] "" Vector__XXX
 SG_ MC_LIMIT_BusVoltageUpper : 4|1@1+ (1,0) [0|1] "" Vector__XXX
 SG_ MC_LIMIT_BusVoltageLower : 5|1@1+ (1,0) [0|1] "" Vector__XXX
 SG_ MC_LIMIT_MotorTemp : 6|1@1+ (1,0) [0|1] "" Vector__XXX
 SG_ MC_LIMIT_Reserved : 7|9@1+ (1,0) [0|511] "" Vector__XXX
 SG_ MC_FAULT_HardwareOverCurrent : 16|1@1+ (1,0) [0|1] "" Vector__XXX
 SG_ MC_FAULT_SoftwareOverCurrent : 17|1@1+ (1,0) [0|1] "" Vector__XXX
 SG_ MC_FAULT_DcBusOverVoltage : 18|1@1+ (1,0) [0|1] "" Vector__XXX
 SG_ MC_FAULT_BadMotorPositionHallSeq : 19|1@1+ (1,0) [0|1] "" Vector__XXX
 SG_ MC_FAULT_WatchdogCausedLastReset : 20|1@1+ (1,0) [0|1] "" Vector__XXX
 SG_ MC_FAULT_ConfigRead : 21|1@1+ (1,0) [0|1] "" Vector__XXX
 SG_ MC_FAULT_15vRailUnderVoltage : 22|1@1+ (1,0) [0|1] "" Vector__XXX
 SG_ MC_FAULT_DesaturationFault : 23|1@1+ (1,0) [0|1] "" Vector__XXX
 SG_ MC_FAULT_MotorOverSpeed : 24|1@1+ (1,0) [0|1] "" Vector__XXX
 SG_ MC_FAULT_Reserved : 25|7@1+ (1,0) [0|0] "" Vector__XXX
 SG_ MC_ActiveMotor : 32|16@1+ (1,0) [0|0] "" Vector__XXX
 SG_ MC_TxErrorCount : 48|8@1+ (1,0) [0|0] "" Vector__XXX
 SG_ MC_RxErrorCount : 56|8@1+ (1,0) [0|0] "" Vector__XXX

BO_ 1058 MC_BusMeasurement: 8 WS22
 SG_ MC_BusVoltage : 0|32@1- (1,0) [0|0] "V" Vector__XXX
 SG_ MC_BusCurrent : 32|32@1- (1,0) [0|0] "A" Vector__XXX

BO_ 1059 MC_VelocityMeasurement: 8 WS22
 SG_ MC_MotorVelocity : 0|32@1- (1,0) [0|0] "rpm" Vector__XXX
 SG_ MC_VehicleVelocity : 32|32@1- (1,0) [0|0] "m/s" Vector__XXX

BO_ 1060 MC_PhaseCurrentMeasurement: 8 WS22
 SG_ MC_PhaseCurrentB : 0|32@1- (1,0) [0|0] "A" Vector__XXX
 SG_ MC_PhaseCurrentC : 32|32@1- (1,0) [0|0] "A" Vector__XXX

BO_ 1061 MC_MotorVoltageVectorMeasurement: 8 WS22
 SG_ MC_Vq : 0|32@1- (1,0) [0|0] "V" Vector__XXX
 SG_ MC_Vd : 32|32@1- (1,0) [0|0] "V" Vector__XXX

BO_ 1062 MC_MotorCurrentVectorMeasurement: 8 WS22
 SG_ MC_Iq : 0|32@1- (1,0) [0|0] "A" Vector__XXX
 SG_ MC_Id : 32|32@1- (1,0) [0|0] "A" Vector__XXX

BO_ 1063 MC_BackEMFMeasurementPrediction: 8 WS22
 SG_ MC_BEMFq : 0|32@1- (1,0) [0|0] "V" Vector__XXX
 SG_ MC_BEMFd : 32|32@1- (1,0) [0|0] "V" Vector__XXX

BO_ 1064 MC_15V_RailMeasurement: 8 WS22
 SG_ MC_Supply15V : 32|32@1- (1,0) [0|0] "V" Vector__XXX

BO_ 1065 MC_3V3_19V_RailMeasurement: 8 WS22
 SG_ MC_Supply1V9 : 0|32@1- (1,0) [0|0] "V" Vector__XXX
 SG_ MC_Supply3V3 : 32|32@1- (1,0) [0|0] "V" Vector__XXX

BO_ 1066 WS22Reserved0A: 8 WS22

BO_ 1067 MC_Motor_TempMeasurement: 8 WS22
 SG_ MC_MotorTemp : 0|32@1- (1,0) [0|0] "degC" Vector__XXX
 SG_ MC_HeatsinkTemp : 32|32@1- (1,0) [0|0] "degC" Vector__XXX

BO_ 1068 MC_DspBoardTempMeasurement: 8 WS22
 SG_ MC_DspBoardTemp : 0|32@1- (1,0) [0|0] "degC" Vector__XXX

BO_ 1069 WS22Reserved0D: 8 WS22

BO_ 1070 MC_OdometerBusAhMeasurement: 8 WS22
 SG_ MC_TripOdometer : 0|32@1- (1,0) [0|0] "m" Vector__XXX
 SG_ MC_DCBusAh : 32|32@1- (1,0) [0|0] "Ah" Vector__XXX

BO_ 1079 MC_SlipSpeedMeasurement: 8 WS22
 SG_ MC_SlipSpeed : 0|32@1- (1,0) [0|0] "Hz" Vector__XXX

CM_ BO_ 1025 "Fixed WS22 classic CAN: little-endian IEEE-754 floats; vendor units and wire layout are exempt from team scaling. All WS22 frames have eight data bytes.";
CM_ SG_ 1025 MC_MotorCurrentSetpoint "Vendor current fraction: 0.0 to 1.0, never 0 to 100.";
CM_ SG_ 1025 MC_MotorVelocitySetpoint "Signed velocity setpoint; reverse requires negative rpm. Operational limits are controller settings, not wire limits.";
CM_ BO_ 1026 "Fixed WS22 classic CAN: little-endian IEEE-754 floats; vendor units and wire layout are exempt from team scaling. All WS22 frames have eight data bytes.";
CM_ SG_ 1026 MC_MotorPowerSetpoint "Vendor current fraction: 0.0 to 1.0, never 0 to 100.";
CM_ BO_ 1027 "Defined WS22 reset trigger: eight unused data bytes, transmitted as zeros.";
CM_ BO_ 1056 "Fixed WS22 classic CAN: little-endian IEEE-754 floats; vendor units and wire layout are exempt from team scaling. All WS22 frames have eight data bytes.";
CM_ SG_ 1056 MC_SerialNumber "Device serial number, allocated at manufacture.";
CM_ SG_ 1056 MC_TritiumID "Device identifier. 0x00004003";
CM_ BO_ 1057 "Fixed WS22 classic CAN: little-endian IEEE-754 floats; vendor units and wire layout are exempt from team scaling. All WS22 frames have eight data bytes.";
CM_ SG_ 1057 MC_RxErrorCount "The DSP CAN receive error counter (CAN 2.0)";
CM_ SG_ 1057 MC_TxErrorCount "The DSP CAN transmission error counter (CAN 2.0)";
CM_ SG_ 1057 MC_ActiveMotor "The index of the active motor currently being used.";
CM_ SG_ 1057 MC_FAULT_Reserved "Vendor-reserved bits; no enum semantics assigned.";
CM_ SG_ 1057 MC_LIMIT_Reserved "Vendor-reserved bits; no enum semantics assigned.";
CM_ BO_ 1058 "Fixed WS22 classic CAN: little-endian IEEE-754 floats; vendor units and wire layout are exempt from team scaling. All WS22 frames have eight data bytes.";
CM_ SG_ 1058 MC_BusCurrent "Current drawn from the DC bus by the controller.";
CM_ SG_ 1058 MC_BusVoltage "DC bus voltage at the controller.";
CM_ BO_ 1059 "Fixed WS22 classic CAN: little-endian IEEE-754 floats; vendor units and wire layout are exempt from team scaling. All WS22 frames have eight data bytes.";
CM_ SG_ 1059 MC_VehicleVelocity "Vehicle velocity in metres / second.";
CM_ SG_ 1059 MC_MotorVelocity "Motor angular frequency in revolutions per minute.";
CM_ BO_ 1060 "Fixed WS22 classic CAN: little-endian IEEE-754 floats; vendor units and wire layout are exempt from team scaling. All WS22 frames have eight data bytes.";
CM_ SG_ 1060 MC_PhaseCurrentC "RMS current in motor Phase C.";
CM_ SG_ 1060 MC_PhaseCurrentB "RMS current in motor Phase B.";
CM_ BO_ 1061 "Fixed WS22 classic CAN: little-endian IEEE-754 floats; vendor units and wire layout are exempt from team scaling. All WS22 frames have eight data bytes.";
CM_ SG_ 1061 MC_Vd "Real component of the applied non-rotating voltage vector to the motor.";
CM_ SG_ 1061 MC_Vq "Imaginary component of the applied non-rotating voltage vector to the motor.";
CM_ BO_ 1062 "Fixed WS22 classic CAN: little-endian IEEE-754 floats; vendor units and wire layout are exempt from team scaling. All WS22 frames have eight data bytes.";
CM_ SG_ 1062 MC_Id "Real component of the applied non-rotating current vector to the motor. This vector represents the field current of the motor.";
CM_ SG_ 1062 MC_Iq "Imaginary component of the applied non-rotating current vector to the motor. This current produces torque in the motor and should be in phase with the back-EMF of the motor";
CM_ BO_ 1063 "Fixed WS22 classic CAN: little-endian IEEE-754 floats; vendor units and wire layout are exempt from team scaling. All WS22 frames have eight data bytes.";
CM_ SG_ 1063 MC_BEMFd "By definition this value is always 0V.";
CM_ SG_ 1063 MC_BEMFq "The peak of the phase to neutral motor voltage.";
CM_ BO_ 1064 "Fixed WS22 classic CAN: little-endian IEEE-754 floats; vendor units and wire layout are exempt from team scaling. All WS22 frames have eight data bytes.";
CM_ SG_ 1064 MC_Supply15V "Actual voltage level of the 15V power rail.";
CM_ BO_ 1065 "Fixed WS22 classic CAN: little-endian IEEE-754 floats; vendor units and wire layout are exempt from team scaling. All WS22 frames have eight data bytes.";
CM_ SG_ 1065 MC_Supply3V3 "Actual voltage level of the 3.3V power rail.";
CM_ SG_ 1065 MC_Supply1V9 "Actual voltage level of the 1.9V DSP power rail.";
CM_ BO_ 1066 "Vendor-defined reserved frame; fixed eight-byte payload, no signals assigned.";
CM_ BO_ 1067 "Fixed WS22 classic CAN: little-endian IEEE-754 floats; vendor units and wire layout are exempt from team scaling. All WS22 frames have eight data bytes.";
CM_ SG_ 1067 MC_HeatsinkTemp "Internal temperature of Heat-sink (case).";
CM_ SG_ 1067 MC_MotorTemp "Internal temperature of the motor";
CM_ BO_ 1068 "Fixed WS22 classic CAN: little-endian IEEE-754 floats; vendor units and wire layout are exempt from team scaling. All WS22 frames have eight data bytes.";
CM_ SG_ 1068 MC_DspBoardTemp "Temperature of the DSP board.";
CM_ BO_ 1069 "Vendor-defined reserved frame; fixed eight-byte payload, no signals assigned.";
CM_ BO_ 1070 "Fixed WS22 classic CAN: little-endian IEEE-754 floats; vendor units and wire layout are exempt from team scaling. All WS22 frames have eight data bytes.";
CM_ SG_ 1070 MC_DCBusAh "Charge flow into the controller DC bus from the time of reset.";
CM_ SG_ 1070 MC_TripOdometer "Distance the vehicle has travelled since reset.";
CM_ BO_ 1079 "Fixed WS22 classic CAN: little-endian IEEE-754 floats; vendor units and wire layout are exempt from team scaling. All WS22 frames have eight data bytes.";
CM_ SG_ 1079 MC_SlipSpeed "Slip speed when driving an induction motor.";
BA_DEF_ SG_  "ValueTable" STRING ;
BA_DEF_ BO_  "LayoutPending" INT 0 1;
BA_DEF_ BO_  "ProtocolSource" STRING ;
BA_DEF_  "BusType" STRING ;
BA_DEF_  "DBName" STRING ;
BA_DEF_ BO_  "GenMsgSendType" ENUM  "Cyclic","Triggered","None";
BA_DEF_ BO_  "GenMsgCycleTime" INT 0 65535;
BA_DEF_  "Baudrate" INT 1 10000000;
BA_DEF_ BO_  "CANFD_BRS" ENUM  "0","1";
BA_DEF_ BO_  "VFrameFormat" ENUM  "StandardCAN","ExtendedCAN","reserved","J1939PG","reserved","reserved","reserved","reserved","reserved","reserved","reserved","reserved","reserved","reserved","StandardCAN_FD","ExtendedCAN_FD";
BA_DEF_DEF_  "ValueTable" "";
BA_DEF_DEF_  "LayoutPending" 0;
BA_DEF_DEF_  "ProtocolSource" "";
BA_DEF_DEF_  "BusType" "CAN";
BA_DEF_DEF_  "DBName" "";
BA_DEF_DEF_  "GenMsgSendType" "Cyclic";
BA_DEF_DEF_  "GenMsgCycleTime" 0;
BA_DEF_DEF_  "CANFD_BRS" "0";
BA_DEF_DEF_  "VFrameFormat" "StandardCAN";
BA_ "DBName" "MotorCAN";
BA_ "Baudrate" 250000;
BA_ "ProtocolSource" BO_ 1025 "Prohelion WS22 Appendix C; legacy HighNoon MotorCAN";
BA_ "GenMsgCycleTime" BO_ 1025 100;
BA_ "ProtocolSource" BO_ 1026 "Prohelion WS22 Appendix C; legacy HighNoon MotorCAN";
BA_ "GenMsgCycleTime" BO_ 1026 100;
BA_ "ProtocolSource" BO_ 1027 "Prohelion WS22 Appendix C; legacy HighNoon MotorCAN";
BA_ "GenMsgSendType" BO_ 1027 1;
BA_ "ProtocolSource" BO_ 1056 "Prohelion WS22 Appendix C; legacy HighNoon MotorCAN";
BA_ "GenMsgCycleTime" BO_ 1056 1000;
BA_ "ProtocolSource" BO_ 1057 "Prohelion WS22 Appendix C; legacy HighNoon MotorCAN";
BA_ "GenMsgCycleTime" BO_ 1057 200;
BA_ "ValueTable" SG_ 1057 MC_FAULT_MotorOverSpeed "FaultState";
BA_ "ValueTable" SG_ 1057 MC_FAULT_DesaturationFault "FaultState";
BA_ "ValueTable" SG_ 1057 MC_FAULT_15vRailUnderVoltage "FaultState";
BA_ "ValueTable" SG_ 1057 MC_FAULT_ConfigRead "FaultState";
BA_ "ValueTable" SG_ 1057 MC_FAULT_WatchdogCausedLastReset "FaultState";
BA_ "ValueTable" SG_ 1057 MC_FAULT_BadMotorPositionHallSeq "FaultState";
BA_ "ValueTable" SG_ 1057 MC_FAULT_DcBusOverVoltage "FaultState";
BA_ "ValueTable" SG_ 1057 MC_FAULT_SoftwareOverCurrent "FaultState";
BA_ "ValueTable" SG_ 1057 MC_FAULT_HardwareOverCurrent "FaultState";
BA_ "ValueTable" SG_ 1057 MC_LIMIT_MotorTemp "OnOff";
BA_ "ValueTable" SG_ 1057 MC_LIMIT_BusVoltageLower "OnOff";
BA_ "ValueTable" SG_ 1057 MC_LIMIT_BusVoltageUpper "OnOff";
BA_ "ValueTable" SG_ 1057 MC_LIMIT_BusCurrent "OnOff";
BA_ "ValueTable" SG_ 1057 MC_LIMIT_Velocity "OnOff";
BA_ "ValueTable" SG_ 1057 MC_LIMIT_MotorCurrent "OnOff";
BA_ "ValueTable" SG_ 1057 MC_LIMIT_OutputVoltagePWM "OnOff";
BA_ "ProtocolSource" BO_ 1058 "Prohelion WS22 Appendix C; legacy HighNoon MotorCAN";
BA_ "GenMsgCycleTime" BO_ 1058 200;
BA_ "ProtocolSource" BO_ 1059 "Prohelion WS22 Appendix C; legacy HighNoon MotorCAN";
BA_ "GenMsgCycleTime" BO_ 1059 200;
BA_ "ProtocolSource" BO_ 1060 "Prohelion WS22 Appendix C; legacy HighNoon MotorCAN";
BA_ "GenMsgCycleTime" BO_ 1060 200;
BA_ "ProtocolSource" BO_ 1061 "Prohelion WS22 Appendix C; legacy HighNoon MotorCAN";
BA_ "GenMsgCycleTime" BO_ 1061 200;
BA_ "ProtocolSource" BO_ 1062 "Prohelion WS22 Appendix C; legacy HighNoon MotorCAN";
BA_ "GenMsgCycleTime" BO_ 1062 200;
BA_ "ProtocolSource" BO_ 1063 "Prohelion WS22 Appendix C; legacy HighNoon MotorCAN";
BA_ "GenMsgCycleTime" BO_ 1063 200;
BA_ "ProtocolSource" BO_ 1064 "Prohelion WS22 Appendix C; legacy HighNoon MotorCAN";
BA_ "GenMsgCycleTime" BO_ 1064 1000;
BA_ "ProtocolSource" BO_ 1065 "Prohelion WS22 Appendix C; legacy HighNoon MotorCAN";
BA_ "GenMsgCycleTime" BO_ 1065 1000;
BA_ "ProtocolSource" BO_ 1066 "2027 allocation draft";
BA_ "GenMsgSendType" BO_ 1066 2;
BA_ "ProtocolSource" BO_ 1067 "Prohelion WS22 Appendix C; legacy HighNoon MotorCAN";
BA_ "GenMsgCycleTime" BO_ 1067 1000;
BA_ "ProtocolSource" BO_ 1068 "Prohelion WS22 Appendix C; legacy HighNoon MotorCAN";
BA_ "GenMsgCycleTime" BO_ 1068 1000;
BA_ "ProtocolSource" BO_ 1069 "2027 allocation draft";
BA_ "GenMsgSendType" BO_ 1069 2;
BA_ "ProtocolSource" BO_ 1070 "Prohelion WS22 Appendix C; legacy HighNoon MotorCAN";
BA_ "GenMsgCycleTime" BO_ 1070 1000;
BA_ "ProtocolSource" BO_ 1079 "Prohelion WS22 Appendix C; legacy HighNoon MotorCAN";
BA_ "GenMsgCycleTime" BO_ 1079 200;
VAL_ 1057 MC_FAULT_MotorOverSpeed 0 "OK" 1 "Fault" ;
VAL_ 1057 MC_FAULT_DesaturationFault 0 "OK" 1 "Fault" ;
VAL_ 1057 MC_FAULT_15vRailUnderVoltage 0 "OK" 1 "Fault" ;
VAL_ 1057 MC_FAULT_ConfigRead 0 "OK" 1 "Fault" ;
VAL_ 1057 MC_FAULT_WatchdogCausedLastReset 0 "OK" 1 "Fault" ;
VAL_ 1057 MC_FAULT_BadMotorPositionHallSeq 0 "OK" 1 "Fault" ;
VAL_ 1057 MC_FAULT_DcBusOverVoltage 0 "OK" 1 "Fault" ;
VAL_ 1057 MC_FAULT_SoftwareOverCurrent 0 "OK" 1 "Fault" ;
VAL_ 1057 MC_FAULT_HardwareOverCurrent 0 "OK" 1 "Fault" ;
VAL_ 1057 MC_LIMIT_MotorTemp 0 "Off" 1 "On" ;
VAL_ 1057 MC_LIMIT_BusVoltageLower 0 "Off" 1 "On" ;
VAL_ 1057 MC_LIMIT_BusVoltageUpper 0 "Off" 1 "On" ;
VAL_ 1057 MC_LIMIT_BusCurrent 0 "Off" 1 "On" ;
VAL_ 1057 MC_LIMIT_Velocity 0 "Off" 1 "On" ;
VAL_ 1057 MC_LIMIT_MotorCurrent 0 "Off" 1 "On" ;
VAL_ 1057 MC_LIMIT_OutputVoltagePWM 0 "Off" 1 "On" ;
SIG_VALTYPE_ 1025 MC_MotorVelocitySetpoint : 1;
SIG_VALTYPE_ 1025 MC_MotorCurrentSetpoint : 1;
SIG_VALTYPE_ 1026 MC_MotorPowerSetpoint : 1;
SIG_VALTYPE_ 1058 MC_BusVoltage : 1;
SIG_VALTYPE_ 1058 MC_BusCurrent : 1;
SIG_VALTYPE_ 1059 MC_MotorVelocity : 1;
SIG_VALTYPE_ 1059 MC_VehicleVelocity : 1;
SIG_VALTYPE_ 1060 MC_PhaseCurrentB : 1;
SIG_VALTYPE_ 1060 MC_PhaseCurrentC : 1;
SIG_VALTYPE_ 1061 MC_Vq : 1;
SIG_VALTYPE_ 1061 MC_Vd : 1;
SIG_VALTYPE_ 1062 MC_Iq : 1;
SIG_VALTYPE_ 1062 MC_Id : 1;
SIG_VALTYPE_ 1063 MC_BEMFq : 1;
SIG_VALTYPE_ 1063 MC_BEMFd : 1;
SIG_VALTYPE_ 1064 MC_Supply15V : 1;
SIG_VALTYPE_ 1065 MC_Supply1V9 : 1;
SIG_VALTYPE_ 1065 MC_Supply3V3 : 1;
SIG_VALTYPE_ 1067 MC_MotorTemp : 1;
SIG_VALTYPE_ 1067 MC_HeatsinkTemp : 1;
SIG_VALTYPE_ 1068 MC_DspBoardTemp : 1;
SIG_VALTYPE_ 1070 MC_TripOdometer : 1;
SIG_VALTYPE_ 1070 MC_DCBusAh : 1;
SIG_VALTYPE_ 1079 MC_SlipSpeed : 1;
